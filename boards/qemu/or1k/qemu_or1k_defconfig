## boards/qemu/or1k/qemu_or1k_defconfig
```kconfig
# SPDX-License-Identifier: Apache-2.0

CONFIG_PICOLIBC=y
CONFIG_PICOLIBC_USE_MODULE=y
CONFIG_PICOLIBC_GLOBAL_ERRNO=y

CONFIG_OPENRISC_TICK_TIMER=y
CONFIG_CONSOLE=y
CONFIG_SERIAL=y
CONFIG_UART_CONSOLE=y
CONFIG_STACK_SENTINEL=y
```

## dts/bindings/base/zephyr,memory-region.yaml
```yaml
# Copyright (c) 2021, CSIRO
# SPDX-License-Identifier: Apache-2.0

description: Compatible for devices resulting in linker memory regions

compatible: "zephyr,memory-region"

include: [base.yaml, "zephyr,memory-common.yaml"]

properties:
  zephyr,memory-region:
    required: true

  delay-relocation:
    type: boolean
    description: |
      Delay .data relocation and .bss zero initialization until PRE_KERNEL_1
      initialization levels have completed.
```
